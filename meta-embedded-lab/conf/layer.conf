## meta-embedded-lab/conf/layer.conf
```bitbake
# meta-embedded-lab layer configuration
BBPATH .= ":${LAYERDIR}"
BBFILES += "${LAYERDIR}/recipes-*/*/*.bb ${LAYERDIR}/recipes-*/*/*.bbappend"

BBFILE_COLLECTIONS += "embedded-lab"
BBFILE_PATTERN_embedded-lab := "^${LAYERDIR}/"
BBFILE_PRIORITY_embedded-lab = "7"

LAYERDEPENDS_embedded-lab = "core yocto openembedded-layer"
LAYERSERIES_COMPAT_embedded-lab = "scarthgap walnascar"
```
